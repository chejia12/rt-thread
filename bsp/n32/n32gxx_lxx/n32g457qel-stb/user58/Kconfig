## bsp/n32/n32gxx_lxx/n32g457qel-stb/user58/Kconfig
```kconfig
menu "user driber of 58"
	# NOR Flash+DFS
 	config BRD_DFS_NOR_FLASH
        bool "Enable IN NOR FLASH MOUNT DFS elm or lfs"
        default n
		depends on RT_USING_DFS#正向依赖RT_USING_DFS没有定义这个都不显示
		depends on RT_USING_SFUD#正向依赖RT_USING_SFUD
		depends on RT_USING_DFS_ELMFAT || PKG_USING_LITTLEFS#依赖一种一个定义
        if BRD_DFS_NOR_FLASH
            config SFUD_NOR_FLASH_ATTACH_SPI_BUS
                string "Select the SPI bus connected to the NOR flash"
                default "spi1"
			config SPI_CS_NO_FLASH
				int "select spi cs pin"
				range 0 112
				default 4
            config SFUD_NOR_FLASH_NAME
                string "Set NOR flash block device name"
                default "spi11"
			
        endif
	#HT530 12bit dac
	config BRD_DAC_HT5320
        bool "Enable DAC HT530"
        default n
		depends on RT_USING_SPI
		if BRD_DAC_HT5320
			config BRD_DAC_HT5320_SPI_BUS
                string "select spi  bus of attach nor flash"
                default "spi2"
			config BRD_DAC_HT5320_CH0
				int "select chanel 0  cs pin "
				range 0 112
				default 4
			config BRD_DAC_HT5320_CH1
				int "select chanel 1  cs pin "
				range 0 112
				default 5
			config BRD_DAC_HT5320_CH2
				int "select chanel 2  cs pin "
				range 0 112
				default 6
			config BRD_DAC_HT5320_CH3
				int "select chanel 3  cs pin "
				range 0 112
				default 7
		endif
	#北斗解析库
	config BRD_GPS_BD
        bool "Enable gps and beidou positong"
        default n
        if BRD_GPS_BD
            config BD_DEBUG
                bool "Enable BEI DOU DEBUG"
                default n
        endif
	#MCP4728 是一款由 Microchip（微芯科技）生产的四通道、12位分辨率的数模转换器（DAC）。它通过 I²C 串行接口与控制器通信，并且内置了 EEPROM 非易失性存储器，可以在断电后保存配置和输出值
	config BRD_DAC_MCP4728
        bool "Enable DAC MCP4728"
        default n
		depends on RT_USING_I2C
		if BRD_DAC_MCP4728
			config BRD_DAC_MCP4728_I2C_BUS
                string "select i2c  bus of attach MCP4728"
                default "i2c2"
		endif
	# 观察者模式
	config BRD_OBSERVER
        bool "Enable Observer Design Pattern "
        default y
		if BRD_OBSERVER
			config BRD_OBSERVER_SAMPLE
                bool "Enable Observer Design Pattern use sample "
        		default n
		endif
	#-----------------------------EXT_COUNTER----G457------------------------------
	menuconfig BSP_USING_TIM_EXT_COUNTER
	bool "Enable TIM External Counter"
	default n
	select RT_USING_HWTIMER
	if BSP_USING_TIM_EXT_COUNTER
		config BSP_USING_TIM_EXT_COUNTER_SAMPLE
			bool "Enable TIM External Counter sample"
			default n
		config BSP_USING_TIM1_EXT_COUNTER
			bool "Enable TIM1 External Counter"
			default n
			choice
				prompt "Select TIM1 Pin"
				default TIM1_CH1_PA8
				config TIM1_CH1_PA8
					bool "PA8 AF2"
				config TIM1_CH2_PA9
					bool "PA9 AF2"
			endchoice

		config BSP_USING_TIM2_EXT_COUNTER
			bool "Enable TIM2 External Counter"
			default n
			choice
				prompt "Select TIM2 Pin"
				default TIM2_CH1_PA0
				config TIM2_CH1_PA0
					bool "PA0 AF2"
				config TIM2_CH1_PA15
					bool "PA15 AF5"
				config TIM2_CH2_PA1
					bool "PA1 AF2"
				config TIM2_CH2_PB3
					bool "PB3 AF2"
			endchoice

		config BSP_USING_TIM3_EXT_COUNTER
			bool "Enable TIM3 External Counter"
			default n
			choice
				prompt "Select TIM3 Pin"
				default TIM3_CH1_PA6
				config TIM3_CH1_PA6
					bool "PA6 AF2"
				config TIM3_CH1_PB4
					bool "PB4 AF2"
				config TIM3_CH1_PC6
					bool "PC6 AF2"
				config TIM3_CH2_PA7
					bool "PA7 AF2"
				config TIM3_CH2_PB5
					bool "PB5 AF2"
				config TIM3_CH2_PC7
					bool "PC7 AF2"
			endchoice
	endif#---------BSP_USING_TIM_EXT_COUNTER------------


	

endmenu
```
